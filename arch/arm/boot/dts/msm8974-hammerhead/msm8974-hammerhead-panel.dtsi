/* Copyright (c) 2014, The Linux Foundation. All rights reserved.
 *
 * This program is free software; you can redistribute it and/or modify
 * it under the terms of the GNU General Public License version 2 and
 * only version 2 as published by the Free Software Foundation.
 *
 * This program is distributed in the hope that it will be useful,
 * but WITHOUT ANY WARRANTY; without even the implied warranty of
 * MERCHANTABILITY or FITNESS FOR A PARTICULAR PURPOSE.  See the
 * GNU General Public License for more details.
 */

&mdss_mdp {
	dsi_jdi_command_ors: qcom,mdss_dsi_jdi_command_ors {
		qcom,mdss-dsi-panel-name = "JDI 1080p command mode dsi panel";
		qcom,mdss-dsi-panel-controller = <&mdss_dsi0>;
		qcom,mdss-dsi-panel-type = "dsi_cmd_mode";
		qcom,mdss-dsi-panel-height = <1920>;
		qcom,mdss-dsi-panel-width = <1080>;
		qcom,mdss-dsi-bpp = <24>;
		qcom,mdss-pan-physical-width-dimension = <62>;
		qcom,mdss-pan-physical-height-dimension = <110>;
		qcom,mdss-dsi-panel-destination = "display_1";
		qcom,mdss-dsi-h-sync-skew = <0>;
		qcom,mdss-dsi-h-front-porch = <4>;
		qcom,mdss-dsi-h-pulse-width = <2>;
		qcom,mdss-dsi-h-back-porch = <2>;
		qcom,mdss-dsi-v-back-porch = <2>;
		qcom,mdss-dsi-v-pulse-width = <2>;
		qcom,mdss-dsi-v-front-porch = <2>;
		qcom,mdss-dsi-h-left-border = <0>;
		qcom,mdss-dsi-h-right-border = <0>;
		qcom,mdss-dsi-v-top-border = <0>;
		qcom,mdss-dsi-v-bottom-border = <0>;
		qcom,mdss-dsi-underflow-color = <0xff>;
		qcom,mdss-dsi-bl-min-level = <1>;
		qcom,mdss-dsi-bl-max-level = <255>;
		qcom,mdss-dsi-te-check-enable;
		qcom,mdss-dsi-te-using-te-pin;
		qcom,mdss-dsi-te-pin-select = <1>;
		qcom,mdss-dsi-h-sync-pulse = <0>;
		qcom,mdss-dsi-hfp-power-mode;
		qcom,mdss-dsi-hsa-power-mode;
		qcom,mdss-dsi-hbp-power-mode;
		qcom,mdss-dsi-bllp-power-mode;
		qcom,mdss-dsi-bllp-eof-power-mode;
		qcom,mdss-dsi-virtual-channel-id = <0>;
		qcom,mdss-dsi-color-order = <0>;
		qcom,mdss-dsi-lane-0-state;
		qcom,mdss-dsi-lane-1-state;
		qcom,mdss-dsi-lane-2-state;
		qcom,mdss-dsi-lane-3-state;
		qcom,mdss-dsi-t-clk-pre = <0x35>;
		qcom,mdss-dsi-t-clk-post = <0x1E>;
		qcom,mdss-dsi-stream = <0>;
		qcom,mdss-dsi-mdp-trigger = "none";
		qcom,mdss-dsi-dma-trigger = "trigger_sw";
		qcom,mdss-dsi-panel-framerate = <60>;
		qcom,mdss-dsi-panel-clockrate = <804667392>;
		qcom,mdss-dsi-te-dcs-command = <1>;
		qcom,mdss-dsi-panel-timings = [
			c1 3d 34 00 58 4d
			36 3f 53 03 04 00];
		qcom,mdss-dsi-regulator-settings = [
			03 01 01 00 20 00 01];
		qcom,mdss-dsi-strength-ctrl = [
			bb 06];
		qcom,mdss-dsi-lane-config = [
			00 c2 45 00 00 00 00 01 75
			00 c2 45 00 00 00 00 01 75
			00 c2 45 00 00 00 00 01 75
			00 c2 45 00 00 00 00 01 75
			00 02 45 00 00 00 00 01 97];
		qcom,mdss-dsi-on-command = [
			15 01 00 00 00 00 02 00 00
			39 01 00 00 00 00 05
			FF 19 02 01 00
			15 01 00 00 00 00 02 00 80
			39 01 00 00 00 00 03
			FF 19 02
			15 01 00 00 00 00 02 00 00
			39 01 00 00 00 00 03
			D8 20 20
			15 01 00 00 00 00 02 00 00
			39 01 00 00 00 00 19
			E1 00 0A 11 1B 25
			2D 38 48 53 65 70
			79 80 7B 75 6A 5B
			4E 44 3E 35 26 16
			00
			15 01 00 00 00 00 02 00 00
			39 01 00 00 00 00 19
			E2 00 0A 11 1B 25
			2D 38 48 53 65 70
			79 80 7B 75 6A 5B
			4E 44 3E 35 26 16
			00
			15 01 00 00 00 00 02 00 00
			39 01 00 00 00 00 19
			E3 47 49 4B 4E 51
			54 5A 64 69 75 7C
			82 79 75 6F 64 55
			49 40 3A 32 25 15
			00
			15 01 00 00 00 00 02 00 00
			39 01 00 00 00 00 19
			E4 47 49 4B 4E 51
			54 5A 64 69 75 7C
			82 79 75 6F 64 55
			49 40 3A 32 25 15
			00
			15 01 00 00 00 00 02 00 00
			39 01 00 00 00 00 19
			E5 56 57 59 5B 5E
			60 65 6D 6F 79 7E
			83 78 74 6E 63 54
			47 3D 34 28 21 14
			00
			15 01 00 00 00 00 02 00 00
			39 01 00 00 00 00 19
			E6 56 57 59 5B 5E
			60 65 6D 6F 79 7E
			83 78 74 6E 63 54
			47 3D 34 28 21 14
			00
			15 01 00 00 00 00 02 00 00
			15 01 00 00 00 00 02 00 00
			39 01 00 00 00 00 05
			FF 19 02 01 00
			15 01 00 00 00 00 02 00 80
			39 01 00 00 00 00 03
			FF 19 02
			15 01 00 00 00 00 02 00 83
			15 01 00 00 00 00 02 F3 CA
			15 01 00 00 00 00 02 00 90
			15 01 00 00 00 00 02 C4 00
			15 01 00 00 00 00 02 00 B0
			39 01 00 00 00 00 0F
			C5 92 D6 A0 15 A0 1E A0 06
			A0 0C 44 33 30 88
			15 01 00 00 00 00 02 00 00
			15 01 00 00 00 00 02 35 00
			39 01 00 00 00 00 05
			2A 00 00 04 37
			39 01 00 00 00 00 05
			2B 00 00 07 7F
			05 01 00 00 78 00 01 11
			05 01 00 00 00 00 01 29];
		qcom,mdss-dsi-on-command-state = "dsi_lp_mode";
		qcom,mdss-dsi-off-command = [
			05 01 00 00 32 00 01 28
			05 01 00 00 64 00 01 10];
		qcom,mdss-dsi-off-command-state = "dsi_hs_mode";
		qcom,mdss-dsi-bl-pmic-control-type = "bl_ctrl_wled";
		qcom,cont-splash-enabled;
		qcom,ulps-enabled;
	};
};
